## drivers/amlogic/input/avin/Kconfig
```kconfig
#
# AVIN drivers configuration
#

menuconfig AMLOGIC_AVIN
	tristate "Amlogic AVIN Support"
	default n
	help
	  Say Y here to get to see options for avin drivers.
	  This option alone does not add any kernel code.

	  If you say N, all options in this submenu will be
	  skipped and disabled.


if AMLOGIC_AVIN

config AML_AVIN
	tristate "tv av-in module support"
	default n
	help
		Amlogic TV AV-IN management.


endif
```

## drivers/amlogic/yuvplayer/Kconfig
```kconfig
menu "Amlogic yuvplayer support"

config VIDEOBUF2_ION
	tristate "videobuf2-ion video device support"
	select VIDEO_DEV
	select VIDEO_V4L2
	select VIDEOBUF2_CORE
	select VIDEOBUF2_MEMOPS
	select DMA_SHARED_BUFFER
	default y

	---help---
	capture yuvplayer to user

config AMLOGIC_YUVPLAYER
	tristate "Amlogic ion video device support"
        select VIDEOBUF2_ION
	default y

	---help---
	capture yuvplayer to user
endmenu
```
